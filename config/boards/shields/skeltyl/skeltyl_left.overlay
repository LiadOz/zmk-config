#include "skeltyl.dtsi"
// use pin 18 because pin 10 is busted
&kscan0 {
    row-gpios =
        <&pro_micro 15 GPIO_ACTIVE_HIGH>,
        <&pro_micro 14 GPIO_ACTIVE_HIGH>,
        <&pro_micro 16 GPIO_ACTIVE_HIGH>,
        <&pro_micro 18 GPIO_ACTIVE_HIGH>;
};
