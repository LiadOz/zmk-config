## config/boards/shields/skeltyl/Kconfig.defconfig
```kconfig
if SHIELD_SKELTYL_LEFT

config ZMK_KEYBOARD_NAME
    default "LastHope"

config ZMK_SPLIT_ROLE_CENTRAL
    default y

endif

if SHIELD_SKELTYL_LEFT || SHIELD_SKELTYL_RIGHT

config ZMK_SPLIT
    default y

endif
```

## config/boards/shields/skeltyl/Kconfig.shield
```kconfig
config SHIELD_SKELTYL_LEFT
    def_bool $(shields_list_contains,skeltyl_left)

config SHIELD_SKELTYL_RIGHT
    def_bool $(shields_list_contains,skeltyl_right)
```
